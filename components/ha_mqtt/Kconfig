## components/ha_mqtt/Kconfig
```kconfig
# ha_mqtt 组件配置（menuconfig: Component config -> ha_mqtt）
menu "ha_mqtt（Home Assistant MQTT 接入）"

config HA_MQTT_BROKER_HOST
    string "MQTT Broker 主机（IP/域名）"
    default "192.168.99.253"
    help
        本工程已实测确认：本地 Home Assistant 所在 PC 的 MQTT broker，匿名可用。

config HA_MQTT_PORT
    int "MQTT Broker 端口"
    default 1883

config HA_MQTT_USER
    string "MQTT 用户名（匿名留空）"
    default ""

config HA_MQTT_PASSWORD
    string "MQTT 密码（匿名留空）"
    default ""

config HA_MQTT_CLIENT_ID
    string "MQTT Client ID（留空=自动生成）"
    default ""

config HA_MQTT_TOPIC_NOTIFY
    string "通知订阅主题（HA 推送）"
    default "ha/esp32gw/notify"
    help
        JSON: {"title":"...","message":"...","level":"info|warn|error"}

config HA_MQTT_TOPIC_STATE
    string "状态发布主题（板子 -> HA）"
    default "ha/esp32gw/state"

config HA_MQTT_TOPIC_ALERT
    string "告警发布主题（板子 -> HA，供自动化触发）"
    default "ha/esp32gw/alert"
    help
        板子检测到异常（如传感器掉线/恢复）时向此主题发 JSON：
        {"type":"sensor_offline","message":"...","uptime":123}
        可在 HA 里用 MQTT 触发器自动化转发到手机。

config HA_MQTT_SENSOR_ALERT_MS
    int "传感器掉线告警阈值 (ms)"
    default 120000
    help
        超过该时长未收到传感器数据 → 发告警（同时看板弹通知）。
        传感器上报周期约 15s，默认留 2 分钟容错。

config HA_MQTT_TOPIC_SENSOR
    string "传感器数据订阅主题"
    default "esp32-sensor/data"
    help
        现场 ESP32 传感器节点周期发布的温湿度数据（JSON）：
        {"temp":24.9,"hum":45.2,"rssi":-38,"uptime":14734}

config HA_MQTT_DEVICE_NAME
    string "HA 中显示的设备名称"
    default "Sensor-SU-1"
    help
        MQTT Discovery 发布的 device.name，即 Home Assistant 里该设备显示的名字。

config HA_MQTT_SENSOR_STALE_MS
    int "传感器离线判定超时 (ms)"
    default 60000
    help
        超过该时长未收到传感器数据，看板显示为离线（--）。
        传感器上报周期约 15s，60s 给足重传余量。

config HA_MQTT_HEARTBEAT_MS
    int "状态心跳周期 (ms)"
    default 5000

config HA_MQTT_DISCOVERY_ENABLE
    bool "启用 MQTT Discovery（HA 自动发现实体）"
    default y
    help
        连接成功后向 homeassistant/... 发布 discovery 配置，
        生成 uplink / ip / uptime / notify 四个传感器实体。

config HA_MQTT_NOTIFY_SHOW_MS
    int "看板通知显示时长 (ms)"
    default 10000
    help
        收到 HA 通知后在 LCD 看板显示时长，超时自动恢复常规状态显示。

endmenu
```

## components/lcd_st7735/Kconfig
```kconfig
# lcd_st7735 组件配置（menuconfig: Component config -> lcd_st7735）
menu "lcd_st7735（ST7735S 1.77' TFT 看板）"

config LCD_ST7735_SPI_CLK_HZ
    int "SPI 时钟频率 (Hz)"
    default 40000000
    range 1000000 60000000
    help
        ST7735S 最高支持约 60MHz；40MHz 较稳妥。

config LCD_ST7735_H_RES
    int "面板水平分辨率（0°时）"
    default 128
    help
        应与 board_pins.h 的 BOARD_LCD_H_RES 一致；旋转 90/270 时宽高自动互换。

config LCD_ST7735_V_RES
    int "面板垂直分辨率（0°时）"
    default 160

choice LCD_ST7735_ROTATION
    prompt "屏幕旋转（MADCTL 方向，用于修正面板物理朝向）"
    default LCD_ST7735_ROTATION_0
    help
        旋转后 OFFSET 按查表自动适应（90/270 交换列行偏移）；
        如需完全手工控制偏移，请打开 LCD_ST7735_OFFSET_MANUAL。

config LCD_ST7735_ROTATION_0
    bool "0°（竖屏 128x160）"

config LCD_ST7735_ROTATION_90
    bool "90°（横屏 160x128）"

config LCD_ST7735_ROTATION_180
    bool "180°（竖屏 128x160，上下倒置）"

config LCD_ST7735_ROTATION_270
    bool "270°（横屏 160x128）"

endchoice

config LCD_ST7735_MIRROR_X
    bool "镜像 X（水平翻转）"
    default n
    help
        画面左右颠倒时打开（叠加在旋转之上，用 MADCTL MX 位实现）。

config LCD_ST7735_MIRROR_Y
    bool "镜像 Y（垂直翻转）"
    default n
    help
        画面上下颠倒时打开（叠加在旋转之上，用 MADCTL MY 位实现）。

config LCD_ST7735_OFFSET_X
    int "基准列偏移 OFFSET_X（0°时 CASET 起始；显存132 - 面板128）"
    default 0
    range 0 10
    help
        【本板实测】必须为 0。设为 2 会使 CASET 窗口超出面板实际行宽，导致每行回卷、画面斜切。

config LCD_ST7735_OFFSET_Y
    int "基准行偏移 OFFSET_Y（0°时 RASET 起始；显存162 - 面板160）"
    default 0
    range 0 10

config LCD_ST7735_OFFSET_MANUAL
    bool "手工偏移（关闭自动旋转偏移查表）"
    default n
    help
        开启后所有旋转都直接使用 OFFSET_X/OFFSET_Y，不再自动交换
        （仅调试用，正常工作建议关闭）。

config LCD_ST7735_RGB_BGR
    bool "颜色顺序 BGR（关闭=RGB）"
    default y
    help
        多数 ST7735 模块为 BGR 接线。若红/蓝互换请切换此项。

config LCD_ST7735_INVERT_COLOR
    bool "颜色反转（画面负片时打开）"
    default n

config LCD_ST7735_SCROLL_TEST
    bool "硬件连续滚动测试（绕过 LVGL，VSCRDEF/VSCSAD）"
    default n
    depends on LCD_ST7735_TEST_PATTERN
    help
        开启后绘制测试图并使用 ST7735S VSCRDEF/VSCSAD 持续滚动。
        该模式不会启动 LVGL，仅用于确认面板硬件滚动能力。

config LCD_ST7735_TEST_PATTERN
    bool "测试图诊断模式（绕过 LVGL，固定绘制诊断图）"
    default n
    help
        开启后不再启动 LVGL 看板，直接用 esp_lcd 面板 API 绘制静态测试图：
        1px 白色边框 + 四角 16x16 色块（红/绿/蓝/黄）+ 全屏红/绿/蓝三条竖色带。
        用于单独校准 ROTATION / OFFSET、观察是否偏移 / 裁切 / 斜切。
        关闭后恢复 LVGL 看板。

endmenu
```

## components/market_data/Kconfig
```kconfig
# market_data 组件配置
menu "market_data（futu 持仓与腾讯行情）"

config MARKET_DATA_ENABLED
    bool "启用 futu 持仓与行情同步"
    default y

config MARKET_DATA_API_URL
    string "futu-tracker 持仓 API URL"
    default "https://futu.19831018.xyz/api/positions"
    depends on MARKET_DATA_ENABLED

config MARKET_DATA_API_USER
    string "futu-tracker API 用户名"
    default "admin"
    depends on MARKET_DATA_ENABLED

config MARKET_DATA_API_PASSWORD
    string "futu-tracker API 密码"
    default ""
    depends on MARKET_DATA_ENABLED

config MARKET_DATA_REFRESH_MS
    int "行情刷新周期（毫秒）"
    default 300000
    range 30000 3600000
    depends on MARKET_DATA_ENABLED

config MARKET_DATA_MAX_HOLDINGS
    int "最大持仓数量"
    default 40
    range 1 64
    depends on MARKET_DATA_ENABLED

endmenu
```

## components/net_eth/Kconfig
```kconfig
# net_eth 组件配置（menuconfig: Component config -> net_eth）
menu "net_eth（W5500 有线以太网）"

config NET_ETH_USE_STATIC_IP
    bool "使用静态 IP（默认 DHCP）"
    default n
    help
        置空时使用 DHCP 自动获取；勾选后使用下方四行静态配置。
        注意：静态 IP 需与局域网网段一致，否则无线兜底链路可能被误判优先。

config NET_ETH_STATIC_IP
    string "静态 IP 地址"
    default "192.168.1.100"
    depends on NET_ETH_USE_STATIC_IP

config NET_ETH_NETMASK
    string "子网掩码"
    default "255.255.255.0"
    depends on NET_ETH_USE_STATIC_IP

config NET_ETH_GATEWAY
    string "网关"
    default "192.168.1.1"
    depends on NET_ETH_USE_STATIC_IP

config NET_ETH_DNS
    string "DNS 服务器（静态 IP 时使用）"
    default "8.8.8.8"
    depends on NET_ETH_USE_STATIC_IP

config NET_ETH_SPI_CLK_HZ
    int "W5500 SPI 时钟频率 (Hz)"
    default 10000000
    range 1000000 33000000
    help
        W5500 最高支持约 33MHz。10MHz 最稳妥；短连接线/独占总线时可提高。

endmenu
```

## components/net_wifi/Kconfig
```kconfig
# net_wifi 组件配置（menuconfig: Component config -> net_wifi）
menu "net_wifi（WiFi Station 备用链路）"

config NET_WIFI_SSID
    string "WiFi SSID"
    default "MyWiFi"
    help
        要连接的 2.4G 热点名称（必填，改为你自己的）。

config NET_WIFI_PASSWORD
    string "WiFi 密码"
    default ""
    help
        留空表示开放网络（WIFI_AUTH_OPEN）。

config NET_WIFI_MAX_RETRY
    int "断线最大重连次数"
    default 5
    range 0 100
    help
        连续重连失败达到该次数后停止自动重连，避免无限空转；
        可由上层（net_manager/LCD 业务）按需触发恢复。

config NET_WIFI_USE_STATIC_IP
    bool "使用静态 IP（默认 DHCP）"
    default n
    help
        置空时 WiFi 由 DHCP 自动获取 IP；勾选后使用下方四行静态配置
        （适合路由器无 DHCP 或需固定地址的场景）。

config NET_WIFI_STATIC_IP
    string "静态 IP 地址"
    default "192.168.1.101"
    depends on NET_WIFI_USE_STATIC_IP

config NET_WIFI_NETMASK
    string "子网掩码"
    default "255.255.255.0"
    depends on NET_WIFI_USE_STATIC_IP

config NET_WIFI_GATEWAY
    string "网关"
    default "192.168.1.1"
    depends on NET_WIFI_USE_STATIC_IP

config NET_WIFI_DNS
    string "DNS 服务器（静态 IP 时使用）"
    default "223.5.5.5"
    depends on NET_WIFI_USE_STATIC_IP

endmenu
```

## components/tf_storage/Kconfig
```kconfig
# tf_storage 组件配置（menuconfig: Component config -> tf_storage）
menu "tf_storage（TF 卡历史记录）"

config TF_STORAGE_ENABLE
    bool "启用 TF 卡记录"
    default y
    help
        挂载 microSD 并在其上按天记录传感器/网络/通知等历史数据。
        未插卡时自动降级（仅打印告警，不影响其它功能）。

config TF_STORAGE_MOUNT_POINT
    string "挂载点"
    default "/sdcard"

config TF_STORAGE_LOG_DIR
    string "日志子目录（相对挂载点，留空=根目录）"
    default "logs"

config TF_STORAGE_QUEUE_LEN
    int "写入队列长度"
    default 32

config TF_STORAGE_FORMAT_IF_MOUNT_FAILED
    bool "挂载失败时自动格式化 TF 卡"
    default n
    help
        ⚠️ 危险：开启后，当卡能被识别但文件系统无效时，会自动把卡格式化为 FAT 并
        清空卡上原有数据（仅用于空卡/新卡）。
        注意：如果卡根本没被识别（sdmmc_card_init 超时），本选项无效。

endmenu
```

## components/web_console/Kconfig
```kconfig
# web_console 组件配置（menuconfig: Component config -> web_console）
menu "web_console（Web 控制台）"

config WEB_CONSOLE_PORT
    int "HTTP 端口"
    default 80

config WEB_CONSOLE_MDNS_ENABLE
    bool "启用 mDNS（可用 http://<主机名>.local 访问）"
    default y
    help
        依赖客户端与路由器支持多播；Windows10/11、macOS、iOS、Linux(Avahi) 一般可用。
        不支持时仍可用 IP 访问。

config WEB_CONSOLE_MDNS_HOSTNAME
    string "mDNS 主机名"
    default ""
    help
        访问地址：http://<主机名>.local/

config WEB_CONSOLE_TOKEN
    string "控制操作口令 Token（留空=不校验，不安全）"
    default ""
    help
        仅对“控制类”接口（如 GPIO 设置）校验。可通过 URL 参数 ?token=xxx
        或请求头 X-Auth-Token 传入。

config WEB_CONSOLE_PROTECT_READ
    bool "只读接口（状态/日志/截图）也要求 Token"
    default n

endmenu
```
